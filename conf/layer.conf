## conf/layer.conf
```bitbake
# We have a conf and classes directory, add to BBPATH
BBPATH .= ":${LAYERDIR}"

# We have a packages directory, add to BBFILES
BBFILES += "${LAYERDIR}/recipes-*/*/*.bb \
            ${LAYERDIR}/recipes-*/*/*.bbappend"

BBFILE_COLLECTIONS += "meta-somlabs-desktop"
BBFILE_PATTERN_meta-somlabs-desktop = "^${LAYERDIR}/"
BBFILE_PRIORITY_meta-somlabs-desktop = "10"
LAYERSERIES_COMPAT_meta-somlabs-desktop = "mickledore"
```

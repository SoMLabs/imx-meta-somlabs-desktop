## conf/machine/spacesom-8mplus-cb-desktop.conf
```bitbake
MACHINE="spacesom-8mplus-cb"
require conf/machine/spacesom-8mplus-cb.conf

require conf/machine/include/ubuntubasics.inc

PREFERRED_PROVIDER_virtual/kernel = "linux-imx"
PREFERRED_VERSION_virtual/kernel = "6.6.52"

MACHINE_EXTRA_RRECOMMENDS:remove = "linux-firmware-murata-1zm"
```

## conf/machine/titansbc-8mmini-desktop.conf
```bitbake
MACHINE="titansbc-8mmini"
require conf/machine/titansbc-8mmini.conf

require conf/machine/include/ubuntubasics.inc

PREFERRED_PROVIDER_virtual/kernel = "linux-imx"
PREFERRED_VERSION_virtual/kernel = "6.6.52"
```

## conf/machine/visionsom-8mm-cb-desktop.conf
```bitbake
MACHINE="visionsom-8mm-cb"
require conf/machine/visionsom-8mm-cb.conf

require conf/machine/include/ubuntubasics.inc

PREFERRED_PROVIDER_virtual/kernel = "linux-imx"
PREFERRED_VERSION_virtual/kernel = "6.6.52"
```
